## config/west.yml
```yaml
manifest:
  remotes:
    - name: zmkfirmware
      url-base: https://github.com/zmkfirmware
    - name: PandaKBLab
      url-base: https://github.com/PandaKBLab
    - name: mctechnology17
      url-base: https://github.com/mctechnology17
    - name: m165437
      url-base: https://github.com/M165437 
  projects:
    - name: zmk
      remote: zmkfirmware
      revision: main
      import: app/west.yml
    - name: zmk-for-PandaKB
      remote: PandaKBLab
      revision: PandaKB_Lily58
    - name: zmk-nice-oled
      remote: mctechnology17
      revision: main
   - name: nice-view-gem 
      remote: m165437 
      revision: main 
  self:
    path: config
```
